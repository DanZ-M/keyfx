## Kconfig
```kconfig
config KEYFX
	bool "keyfx WS2812 light engine (indicators, effects, left/right sync)"
	default y
	depends on DT_HAS_KEYFX_LED_OVERLAY_ENABLED

if KEYFX

config KEYFX_HALF
	int "Which half of CI_KEYS this firmware lights: 1 = left, 2 = right, 0 = automatic"
	default 0
	range 0 2
	help
	  Automatic means the central half is the left one and the peripheral is the right
	  one (a normal two-part keyboard). With a dongle both halves are peripherals, so the
	  shield sets this: 1 for the left half, 2 for the right half. The dongle itself has no
	  LED strip and keyfx there only works out what the halves have to show.

config KEYFX_CAPS_WORD_PEEK
	bool "Detect caps word by reading the caps word behavior's state"
	default y
	help
	  ZMK has no public caps word state. This reads the 'active' flag the behavior
	  keeps as the first member of its data. Disable it if a ZMK update breaks it;
	  CI_CAPS_WORD rules then stay off.

config KEYFX_ACTION_HOOK
	bool "Light effects that follow ZMK combos, macros and behaviors (no keymap changes)"
	default y
	depends on !ZMK_SPLIT || ZMK_SPLIT_ROLE_CENTRAL
	help
	  Intercepts ZMK's behavior invocations at link time to start the effects listed in
	  CI_ACTIONS. Disable it if a ZMK update breaks the build; CI_ACTIONS then do nothing.

endif # KEYFX

rsource "lab/Kconfig"
```

## dts/bindings/keyfx,led-overlay.yaml
```yaml
description: |
  LED strip wrapper. Forwards frames to the real strip after painting indicator
  colours (caps lock, num lock, layers) over them.

compatible: "keyfx,led-overlay"

include: base.yaml

properties:
  strip:
    type: phandle
    required: false
    description: |
      The real LED strip (e.g. the ws2812 node). Leave it out on a dongle that has no LEDs:
      keyfx then only computes the lights and sends them to the keyboard halves.
  chain-length:
    type: int
    required: true
    description: Number of LEDs; must match the real strip (any number >= 1 without a strip)
```

## dts/bindings/zmk,behavior-keyfx-wrap.yaml
```yaml
description: |
  Plays a keyfx light effect (by name, from config/keyfx_config.h) and then runs the
  wrapped binding. Use it anywhere a binding is accepted: combos, macros, tap dances,
  hold taps, layer keys. The effect starts exactly when ZMK runs the action.

compatible: "zmk,behavior-keyfx-wrap"

include: zero_param.yaml

properties:
  bindings:
    type: phandle-array
    required: true
    description: The binding to run (exactly one)
  fx-name:
    type: string
    required: true
    description: Name of an effect declared with CI_EFFECT in keyfx_config.h
  origin-position:
    type: int
    default: 255
    description: |
      Key position (0-41) the effect starts from. 255 = the position of the key that
      triggered it (combos have no real position, so they start at position 0).
```

## dts/bindings/zmk,behavior-keyfx.yaml
```yaml
description: keyfx light effects control (splash toggle, play effect) and left/right state sync

compatible: "zmk,behavior-keyfx"

include: two_param.yaml
```

## lab/Kconfig
```kconfig
# Test hardware on the dongle (joystick, MPU6050). Independent of the keyfx light engine.
menu "keyfx dongle lab (test hardware on the dongle)"

config KEYFX_LAB_JOYSTICK
	bool "Analog joystick as pointing device (keyfx,joystick)"
	default y
	depends on DT_HAS_KEYFX_JOYSTICK_ENABLED
	select ADC
	select INPUT
	select GPIO
	help
	  Reads two ADC channels and the push button and reports them as mouse movement
	  (or scrolling) and left click through ZMK's input listener.

if KEYFX_LAB_JOYSTICK

choice KEYFX_LAB_JOY_MODE
	prompt "What the stick does"
	default KEYFX_LAB_JOY_MODE_MOUSE

config KEYFX_LAB_JOY_MODE_MOUSE
	bool "Mouse pointer"

config KEYFX_LAB_JOY_MODE_SCROLL
	bool "Scroll wheel (vertical and horizontal)"

endchoice

config KEYFX_LAB_JOY_SPEED
	int "Speed at full deflection (pixels per second, or wheel steps per second)"
	default 900 if KEYFX_LAB_JOY_MODE_MOUSE
	default 12

config KEYFX_LAB_JOY_DEADZONE
	int "Dead zone around the centre (percent of the stick travel)"
	default 12
	range 0 60

config KEYFX_LAB_JOY_RANGE
	int "ADC counts from the centre position to the end of the travel"
	default 1600
	range 200 2000
	help
	  12 bit readings on a 3.3 V supply: the centre is about 1870 and the ends about 0 and
	  3750, so about 1600 counts either way leaves a little margin. Turn on
	  KEYFX_LAB_JOY_DEBUG to see the real values.

config KEYFX_LAB_JOY_POLL_MS
	int "Sampling period (ms)"
	default 10
	range 5 50

config KEYFX_LAB_JOY_DEBUG
	bool "Log the raw readings twice a second (needs ZMK_USB_LOGGING)"

endif # KEYFX_LAB_JOYSTICK

config KEYFX_LAB_IMU
	bool "MPU6050: print the readings over the USB serial log"
	default y
	depends on DT_HAS_INVENSENSE_MPU6050_ENABLED && !KEYFX_LAB_IMU_MOUSE
	select SENSOR
	imply MPU6050
	help
	  First bring-up test: logs acceleration (in milli-g) and rotation speed once per period.

config KEYFX_LAB_IMU_PERIOD_MS
	int "IMU print period (ms)"
	default 500
	depends on KEYFX_LAB_IMU

config KEYFX_LAB_IMU_MOUSE
	bool "Motion sensor (MPU6050) as pointing device (keyfx,imu-mouse)"
	default y
	depends on DT_HAS_KEYFX_IMU_MOUSE_ENABLED
	select SENSOR
	select INPUT
	select GPIO
	imply MPU6050
	help
	  Tilt the dongle to move the pointer, or turn it like an air mouse. This replaces the
	  plain serial-log test above, because both would read the same sensor.

if KEYFX_LAB_IMU_MOUSE

choice KEYFX_LAB_IMU_MODE
	prompt "How the motion moves the pointer"
	default KEYFX_LAB_IMU_MODE_TILT

config KEYFX_LAB_IMU_MODE_TILT
	bool "Tilt (the further you tilt, the faster it moves)"

config KEYFX_LAB_IMU_MODE_GYRO
	bool "Air mouse (rotation speed)"

endchoice

config KEYFX_LAB_IMU_SPEED
	int "Tilt mode: speed at full tilt (pixels per second)"
	default 700

config KEYFX_LAB_IMU_TILT_RANGE
	int "Tilt mode: tilt in milli-g that counts as full tilt"
	default 500
	range 100 1000
	help
	  500 mg is about 30 degrees.

config KEYFX_LAB_IMU_TILT_DEADZONE
	int "Tilt mode: dead zone around the neutral pose (percent of the range)"
	default 10
	range 0 60

config KEYFX_LAB_IMU_GYRO_GAIN
	int "Air mouse mode: pixels per degree turned"
	default 15

config KEYFX_LAB_IMU_GYRO_DEADZONE
	int "Air mouse mode: ignore rotation slower than this (milli-degrees per second)"
	default 1200

config KEYFX_LAB_IMU_POLL_MS
	int "Sampling period (ms)"
	default 10
	range 5 50

config KEYFX_LAB_IMU_DEBUG
	bool "Log the readings twice a second (needs the zmk-usb-logging snippet)"

endif # KEYFX_LAB_IMU_MOUSE

endmenu
```
